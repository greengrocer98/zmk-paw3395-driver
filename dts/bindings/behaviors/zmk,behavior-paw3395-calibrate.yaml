## dts/bindings/behaviors/zmk,behavior-paw3395-calibrate.yaml
```yaml
description: PAW3395 calibrate behavior
compatible: "zmk,behavior-paw3395-calibrate"
include: zero_param.yaml

properties:
  bindings:
    type: phandle
    required: true
    description: The PAW3395 sensor instance

  feedback-gpios:
    type: phandle-array
    required: false

  feedback-extra-gpios:
    type: phandle-array
    required: false

  feedback-duration:
    type: int
    default: 0
    description: Duration of the feedback pulse in ms
```

## dts/bindings/behaviors/zmk,behavior-paw3395-power-mode-toggle.yaml
```yaml
description: PAW3395 power mode toggle behavior
compatible: "zmk,behavior-paw3395-power-mode-toggle"
include: two_param.yaml

properties:
  bindings:
    type: phandle
    required: true
    description: The PAW3395 sensor instance

  feedback-gpios:
    type: phandle-array
    required: false

  feedback-extra-gpios:
    type: phandle-array
    required: false

  feedback-duration:
    type: int
    default: 0
    description: Duration of the feedback pulse in ms
```
